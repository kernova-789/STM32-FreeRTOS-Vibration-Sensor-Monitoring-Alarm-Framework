#include "screen.h"
#include "spi.h"
#include "stdint.h"
#include "stm32f1xx_hal.h"
#include "stm32f1xx_hal_gpio.h"

static const uint8_t screen_font_bitmap[];

static void Write(uint8_t _data, uint8_t di) {
  // di=0 时发送命令，di=1 时发送数据。
  HAL_GPIO_WritePin(GPIOA, GPIO_PIN_10, di);
  /* 片选有效。 */
  HAL_GPIO_WritePin(GPIOA, GPIO_PIN_8, GPIO_PIN_RESET);
  HAL_SPI_Transmit(&hspi2, &_data, 1, 100);
  /* 片选无效。 */
  HAL_GPIO_WritePin(GPIOA, GPIO_PIN_8, GPIO_PIN_SET);
}

/* 显示单个汉字。 */
static void Disp_HZ16(uint8_t uc_RowNo, uint8_t uc_ColNo,
                      uint8_t uc_HZCode) {
  uint8_t uc_PageCnt, uc_ColCnt;
  uint8_t uc_PageAddr;

  uc_PageAddr = 0xB0 | (uc_RowNo * 2);

  for (uc_PageCnt = 0; uc_PageCnt < 2; uc_PageCnt++) {
    Write(uc_PageAddr, 0); // 设置页地址。

    Write(0x10 | ((uc_ColNo >> 4) & 0x0F), 0); // 设置列地址高 4 位。
    Write(0x00 | (uc_ColNo & 0x0F), 0);        // 设置列地址低 4 位。
    /* 一个 16×16 汉字占两个页，每页写入 16 列。 */
    for (uc_ColCnt = 0; uc_ColCnt < 16; uc_ColCnt++)
      /* 每个汉字字模占 32 字节：两个页，每页 16 字节。 */
      Write(screen_font_bitmap[uc_HZCode * 32 + uc_PageCnt * 16 + uc_ColCnt],
            1);
    uc_PageAddr++;
  }
}
void Disp_HZ16str(uint8_t uc_RowNo, uint8_t uc_ColNo,
                  const uint8_t *HZinf,
                  uint8_t uc_HZCnt) {
  uint8_t uc_CharCnt;

  for (uc_CharCnt = 0; uc_CharCnt < uc_HZCnt; uc_CharCnt++) {
    Disp_HZ16(uc_RowNo, uc_ColNo, HZinf[uc_CharCnt]);
    uc_ColNo = uc_ColNo + 16;
  }
}

void Clear_Screen(void) {
  // 遍历全部 8 个页（Page 0～Page 7）。
  for (uint8_t page = 0; page < 8; page++) {
    Write(0xB0 | page, 0); // 设置页地址。
    Write(0x10, 0);        // 设置列地址高 4 位为 0。
    Write(0x00, 0);        // 设置列地址低 4 位为 0。
    // 再次确认起始列为 0。
    Write(0x10, 0);
    Write(0x00, 0);

    // 向当前页的 128 列写入 0x00。
    for (uint8_t col = 0; col < 128; col++) {
      Write(0x00, 1); // 发送数据 0x00。
    }
  }
  HAL_Delay(10); // 清屏后短暂延时。
  // 清屏结束。
}

void ScreenInit(void) {
  /* 复位有效。 */
  HAL_GPIO_WritePin(GPIOA, GPIO_PIN_9, GPIO_PIN_RESET);
  HAL_Delay(100);
  /* 复位无效。 */
  HAL_GPIO_WritePin(GPIOA, GPIO_PIN_9, GPIO_PIN_SET);
  HAL_Delay(100);

  Write(0xE2, 0); // 软件复位。
  HAL_Delay(10);

  Write(0x29, 0); // 设置电源控制。
  HAL_Delay(10);
  Write(0x2B, 0); // 设置电源控制。
  HAL_Delay(10);
  Write(0x2F, 0); // 开启电源。
  HAL_Delay(100);

  Write(0x24, 0); // 设置内部电阻分压比 (1+Rb/Ra)，100 对应 5.0。
  HAL_Delay(10);
  Write(0x81, 0); // 设置对比度命令。
  Write(0x20, 0); // 设置对比度；可在 0x00～0x3F 范围内调节。
  HAL_Delay(10);

  Write(0xA2, 0); // 设置 1/9 偏压。
  HAL_Delay(10);
  Write(0xA0, 0); // 设置 SEG0～SEG131 扫描方向。
  HAL_Delay(10);
  Write(0xC8, 0); // 设置 COM63～COM0 公共电极扫描方向。
  HAL_Delay(10);

  Write(0xAF, 0); // 开启显示。
  HAL_Delay(10);
  Write(0xA4, 0); // 正常显示。
  HAL_Delay(10);

  Clear_Screen();
}

/* ==============================字库============================== */
static const uint8_t screen_font_bitmap[] =
{
0x80,0x80,0x84,0x84,0x84,0xFE,0x82,0x83,0x82,0x80,0xFF,0x80,0x80,0x80,0x80,0x00,
0x00,0x80,0x40,0x20,0x18,0x07,0x00,0x00,0x00,0x00,0xFF,0x00,0x00,0x00,0x00,0x00,/*"升",0*/
0x20,0x30,0xAC,0x63,0x30,0x00,0x02,0x02,0xFE,0x02,0x02,0x62,0x5A,0xC6,0x00,0x00,
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0x00,0x00,0x00,0x3F,0x10,0x28,0x60,0x3F,0x10,0x10,0x01,0x0E,0x30,0x40,0xF0,0x00,/*"试",15*/

};
